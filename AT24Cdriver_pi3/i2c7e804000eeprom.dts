/dts-v1/;
/plugin/;
/{
	fragment@0 {
		target = <0x2a>;
		__overlay__ {
		#address-cells = <0x01>;
		#size-cells = <0x00>;
			AT24C256@50 {
				compatible = "AT24C256";
				reg = <0x50>;
				status = "okay";
				bytesize = <0x8000>;	
			};
		};
	};
};
